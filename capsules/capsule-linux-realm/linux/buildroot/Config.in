## capsules/capsule-linux-realm/linux/buildroot/Config.in
```kconfig
menu "AOS Realm development tools"

source "$BR2_EXTERNAL_AOS_PATH/package/aos-ninja/Config.in"
source "$BR2_EXTERNAL_AOS_PATH/package/aos-rust-toolchain/Config.in"

endmenu
```

## capsules/capsule-linux-realm/linux/buildroot/configs/aos_rv64_defconfig
```kconfig
BR2_riscv=y
BR2_riscv_custom=y
BR2_RISCV_ISA_RVM=y
BR2_RISCV_ISA_RVA=y
BR2_RISCV_ISA_RVF=y
BR2_RISCV_ISA_RVD=y
BR2_RISCV_ISA_RVC=y
BR2_RISCV_64=y
BR2_RISCV_ABI_LP64D=y
BR2_KERNEL_HEADERS_6_18=y
BR2_TOOLCHAIN_BUILDROOT_GLIBC=y
BR2_TOOLCHAIN_BUILDROOT_CXX=y
BR2_SHARED_LIBS=y
BR2_REPRODUCIBLE=y
BR2_DOWNLOAD_FORCE_CHECK_HASHES=y
BR2_PRIMARY_SITE="https://sources.buildroot.net"
BR2_INIT_NONE=y
BR2_ROOTFS_DEVICE_CREATION_STATIC=y
BR2_ROOTFS_STATIC_DEVICE_TABLE="$(BR2_EXTERNAL_AOS_PATH)/board/aos/device-table.txt"
# BR2_TARGET_ENABLE_ROOT_LOGIN is not set
BR2_TARGET_GENERIC_HOSTNAME="aos-realm"
BR2_TARGET_GENERIC_ISSUE=""
BR2_SYSTEM_BIN_SH_BUSYBOX=y
BR2_PACKAGE_BUSYBOX_SHOW_OTHERS=y
BR2_PACKAGE_BASH=y
BR2_PACKAGE_BINUTILS=y
BR2_PACKAGE_BINUTILS_TARGET=y
BR2_PACKAGE_CA_CERTIFICATES=y
BR2_PACKAGE_CLANG=y
BR2_PACKAGE_CMAKE_CTEST=y
BR2_PACKAGE_GIT=y
BR2_PACKAGE_MAKE=y
BR2_PACKAGE_AOS_NINJA=y
BR2_PACKAGE_PATCH=y
BR2_PACKAGE_PKGCONF=y
BR2_PACKAGE_PYTHON3=y
BR2_PACKAGE_PYTHON3_PY_PYC=y
BR2_PACKAGE_PYTHON3_BZIP2=y
BR2_PACKAGE_PYTHON3_DECIMAL=y
BR2_PACKAGE_PYTHON3_SSL=y
BR2_PACKAGE_PYTHON3_SQLITE=y
BR2_PACKAGE_PYTHON3_XZ=y
BR2_PACKAGE_PYTHON3_ZLIB=y
BR2_PACKAGE_STRACE=y
BR2_PACKAGE_AOS_RUST_TOOLCHAIN=y
BR2_ROOTFS_USERS_TABLES="$(BR2_EXTERNAL_AOS_PATH)/board/aos/users.txt"
BR2_ROOTFS_POST_BUILD_SCRIPT="$(BR2_EXTERNAL_AOS_PATH)/board/aos/post-build.sh"
BR2_ROOTFS_POST_FAKEROOT_SCRIPT="$(BR2_EXTERNAL_AOS_PATH)/board/aos/post-fakeroot.sh"
BR2_TARGET_ROOTFS_CPIO=y
BR2_TARGET_ROOTFS_CPIO_GZIP=y
# BR2_TARGET_ROOTFS_TAR is not set
```

## capsules/capsule-linux-realm/linux/buildroot/package/aos-rust-toolchain/Config.in
```kconfig
config BR2_PACKAGE_AOS_RUST_TOOLCHAIN
	bool "AOS Rust toolchain"
	depends on BR2_RISCV_64
	depends on BR2_RISCV_ISA_RVI
	depends on BR2_RISCV_ISA_RVM
	depends on BR2_RISCV_ISA_RVA
	depends on BR2_RISCV_ISA_RVF
	depends on BR2_RISCV_ISA_RVD
	depends on BR2_RISCV_ISA_RVC
	depends on BR2_TOOLCHAIN_USES_GLIBC
	help
	  Install the official Rust RISC-V host tools and the
	  wasm32-unknown-unknown standard library into AOS Realm. This is a
	  target package: rustc and Cargo execute inside the RISC-V guest.

comment "AOS Rust toolchain needs RV64GC, LP64D, and glibc"
	depends on BR2_RISCV_64
	depends on !BR2_RISCV_ISA_RVF || !BR2_RISCV_ISA_RVD || !BR2_RISCV_ISA_RVC || !BR2_TOOLCHAIN_USES_GLIBC
```
